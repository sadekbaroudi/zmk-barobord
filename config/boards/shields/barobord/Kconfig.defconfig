## config/boards/shields/barobord/Kconfig.defconfig
```kconfig
# Copyright (c) 2021 The ZMK Contributors
# SPDX-License-Identifier: MIT

if SHIELD_BAROBORD

config ZMK_KEYBOARD_NAME
    default "barobord"

endif
```
